/*
 * Copyright (c) 2022 The ZMK Contributors
 *
 * SPDX-License-Identifier: MIT
 */

#include <behaviors.dtsi>
#include <dt-bindings/zmk/keys.h>
#include <dt-bindings/zmk/rgb.h>
#include <dt-bindings/zmk/rgb.h>

/ {
    sensors: sensors {
        compatible = "zmk,keymap-sensors";
        sensors = <&encoder>;
        triggers-per-rotation = <20>;
    };

    keymap {
        compatible = "zmk,keymap";

        default_layer {
            display-name = "Default";
            sensor-bindings = <&inc_dec_kp C_VOL_UP C_VOL_DN>;
            bindings = <&kp C_MUTE>;
        };

    };
};
